## components/environment/Kconfig
```kconfig
menu "Environment sensors"

config ENV_SDA_GPIO
    int "I2C SDA GPIO"
    range 0 48
    default 8

config ENV_SCL_GPIO
    int "I2C SCL GPIO"
    range 0 48
    default 9

config ENV_BMP280_ADDRESS
    hex "BMP280 I2C address (0x76 or 0x77)"
    range 0x76 0x77
    default 0x77

config ENV_SAMPLE_INTERVAL_MS
    int "Sampling interval (ms)"
    range 2000 60000
    default 2000

endmenu
```

## components/modbusTCP/Kconfig
```kconfig
menu "Ingaway Modbus acquisition"
    comment "TCP connection timeout: Component config -> Modbus -> TCP connection timeout"
    config INGAWAY_MB_POLL_INTERVAL_MS
        int "Delay after a successful sample (ms)"
        range 100 60000
        default 2000
    config INGAWAY_MB_RESPONSE_TIMEOUT_MS
        int "Modbus response timeout (ms)"
        range 100 5000
        default 2000
    config INGAWAY_MB_MAX_RETRIES
        int "Additional attempts per acquisition round"
        range 0 5
        default 2
    config INGAWAY_MB_RETRY_DELAY_MS
        int "Delay between attempts (ms)"
        range 100 5000
        default 250
    config INGAWAY_MB_BACKOFF_MIN_MS
        int "Initial reconnect backoff (ms)"
        range 100 60000
        default 1000
    config INGAWAY_MB_BACKOFF_MAX_MS
        int "Maximum reconnect backoff (ms)"
        range 100 300000
        default 30000
    config INGAWAY_MB_STALE_AFTER_MS
        int "Maximum cached sample age (ms)"
        range 100 300000
        default 5000
endmenu
```

## components/mymqtt/Kconfig
```kconfig
menu "Ingaway MQTT upload"
    config INGAWAY_MQTT_BROKER_URI
        string "MQTT TLS broker URI (mqtts://host, no port)"
        default "mqtts://10.30.192.176"
    config INGAWAY_MQTT_BROKER_PORT
        int "MQTT TLS broker port"
        range 1 65535
        default 8883
    config INGAWAY_MQTT_TOPIC_DATA
        string "Telemetry publish topic"
        default "env/telemetry"
    config INGAWAY_MQTT_TOPIC_TEMP
        string "Temperature publish topic (raw value or null)"
        default "env/temp"
    config INGAWAY_MQTT_TOPIC_HEARTBEAT
        string "Heartbeat publish topic"
        default "env/heartbeat"
    config INGAWAY_MQTT_NTP_SERVER
        string "NTP server for TLS certificate time validation"
        default "pool.ntp.org"
endmenu
```

## components/ota_service/Kconfig
```kconfig
menu "Ingaway HTTPS OTA"
    config INGAWAY_OTA_ENABLED
        bool "Enable S3 HTTPS OTA"
        default y

    config INGAWAY_OTA_URL
        string "HTTPS firmware URL"
        depends on INGAWAY_OTA_ENABLED
        default "https://example.com/ingaway/esp32s3/ingaway.bin"
        help
            Direct HTTPS URL of the ESP32-S3 application .bin stored in S3/CloudFront.

    config INGAWAY_OTA_PROJECT_NAME
        string "Expected firmware project/model name"
        depends on INGAWAY_OTA_ENABLED
        default "ingaway"
        help
            The OTA image esp_app_desc.project_name must match this value.

    config INGAWAY_OTA_REQUIRED_FLASH_MB
        int "Required flash size in MiB"
        depends on INGAWAY_OTA_ENABLED
        range 4 128
        default 16

    config INGAWAY_OTA_CHECK_DELAY_MS
        int "Delay after Wi-Fi got IP before OTA check"
        depends on INGAWAY_OTA_ENABLED
        range 0 600000
        default 5000
endmenu
```

## components/w25q64/Kconfig
```kconfig
menu "External W25Q64 storage"

config W25Q64_ENABLED
    bool "Initialize W25Q64 at startup (no erase/format)"
    default y

config W25Q64_CS_GPIO
    int "Chip select GPIO"
    range 0 48
    default 10

config W25Q64_MOSI_GPIO
    int "MOSI GPIO"
    range 0 48
    default 11

config W25Q64_SCLK_GPIO
    int "Clock GPIO"
    range 0 48
    default 12

config W25Q64_MISO_GPIO
    int "MISO GPIO"
    range 0 48
    default 13

config STORAGE_LOG_MIN_LEVEL
    int "Minimum persistent log level (0 Debug, 1 Info, 2 Warn, 3 Error)"
    range 0 3
    default 1

endmenu
```
